## boards/shields/romergo/Kconfig.defconfig
```kconfig
if SHIELD_ROMERGO_LEFT

config ZMK_KEYBOARD_NAME
    default "Romergo"

endif

if SHIELD_ROMERGO_LEFT || SHIELD_ROMERGO_RIGHT

config ZMK_SPLIT
    default y

endif
```

## config/west.yml
```yaml
manifest:
  remotes:
    - name: upstream
      url: https://github.com/zmkfirmware/zmk
  repositories:
    - name: zmk
      remote: upstream
      revision: main
    - name: zmk-config-romergo
      path: zmk-config-romergo
      revision: main
```
