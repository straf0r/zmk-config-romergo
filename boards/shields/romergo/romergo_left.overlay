#include "romergo.dtsi" // The shared dtsi file is included in the overlay

&kscan0 {
    status = "okay";
    compatible = "zmk,kscan-gpio-matrix";
    col-gpios
        = <&pro_micro 5 GPIO_ACTIVE_HIGH>
        , <&pro_micro 6 GPIO_ACTIVE_HIGH>
        , <&pro_micro 7 GPIO_ACTIVE_HIGH>
        , <&pro_micro 8 GPIO_ACTIVE_HIGH>
        , <&pro_micro 9 GPIO_ACTIVE_HIGH>
        ;
};

/ {
    chosen {
        zmk,kscan = &kscan0;
    };
};